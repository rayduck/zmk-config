## config/west.yml
```yaml
manifest:
  remotes:
    - name: zmkfirmware
      url-base: https://github.com/zmkfirmware
    - name: marcoster
      url-base: https://github.com/marcoster
  projects:
    - name: zmk
      remote: marcoster
      revision: marcoster/behavior-key-tap
      import: app/west.yml
  self:
    path: config
```
